## zephyr/Kconfig
```kconfig
menuconfig CANIOT_LIB
        bool "Enable CANIOT_LIB module"
        default n
        help
          Enable support for CANIOT_LIB library

if CANIOT_LIB

module = CANIOTLIB
module-str = CANIOT-LIB

config CANIOT_DEVICE_DRIVERS_API
	bool "Enable Drivers API for device"
		default n
	help
	        Enable Drivers API for device

config CANIOT_LOG_LEVEL
	int "Log level"
        default 3
	help
	        Log level for the CANIOT lib

config CANIOT_ASSERT
	bool "Enable assertion"
	depends on ASSERT
        default n
	help
	        CANIOT assert

config CANIOT_MAX_PENDING_QUERIES
	int "Controller max pending query"
        default 6
	help
	        Controller max pending query

config CANIOT_DRIVERS_API
	bool "Enable Drivers API for device"
        default n
	help
	       Enable Drivers API for device

config CANIOT_CTRL_DRIVERS_API
	bool "Enable Drivers API for controller"
        default n
	help
	        Enable Drivers API for controller

config CANIOT_DEBUG
	bool "Enable debug"
	default n
	help
	        Enable debug

config CHECKS_ENABLED
	bool "Enable checks"
	default y
	help
	        Enable checks
		
config CANIOT_PACK_STRUCTURES
	bool "Enable packed structures"
	default n
	help
	        Enable packed structures

endif
```
